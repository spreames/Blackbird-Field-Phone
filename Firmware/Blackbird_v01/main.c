/*
 * main.c
 *
 * Created: 29-Sep-2025
 * Updated: 9-Nov-2025
 * Author : Steve Reames
 * Released to Creative Commons
 */ 

/* Pinout
	PA0 = UDPI programming pin (in/out)
	PA1 = <unused>
	PA2 = <unused>
	PA3 = <unused>
	PA4 = <unused>
	PA5 = TCB0, WO, Buzz_clk (output)
	PA6 = <unused>
	PA7 = <unused>
	
	PB0 = TCA0, WO0, 20Hz_clk (output)
	PB1 = PushToRing (input)
	PB2 = EnHVpositive (output)
	PB3 - EnHVnegative (output)
	PB4 = 20Hz_clk (input)
	PB5 = CLKOUT (output)
	
	PC0 = Buzz_clk (input)
	PC1 = EnBuzzerAmp (output)
	PC2 = BuzzerAmpInput (output)
	PC3 = IncomingBuzz (input)
*/

#include "Blackbird.h"


/*****************************************************************************/
/*                            Hardware Fuses                                 */
/*****************************************************************************/
//
FUSES = {
	.WDTCFG = PERIOD_OFF_gc || WINDOW_OFF_gc,  /* Watchdog Configuration - off */
	.BODCFG = ACTIVE_DIS_gc,  /* BOD Configuration - BOD disabled */
	.OSCCFG = FREQSEL_16MHZ_gc,  /* Oscillator Configuration */
	//	.reserved_1[2];
	.SYSCFG0 = CRCSRC_NOCRC_gc || RSTPINCFG_UPDI_gc,	/* System Configuration 0 - CRC & UPDI programming pin */
	.SYSCFG1 = SUT_8MS_gc,  /* System Configuration 1 - 8ms wake up */
	.APPEND = 0x00,  /* Application Code Section End */
	.BOOTEND = 0x00,  /* Boot Section End */
};


/*****************************************************************************/
/*                          Global Variables                                 */
/*****************************************************************************/
volatile uint8_t TimerTickFlag;					// flag generated by periodic interrupt
uint8_t OneShot1Counter = 0;
uint8_t OneShot2Counter = 0;
uint8_t OneShot1State = 0;
uint8_t OneShot2State = 0;
uint8_t IncomingBuzz = 0;
uint8_t IncomingBuzzPrevious = 0;
uint8_t IncomingBuzzPreviousPrevious = 0;

uint8_t T20HzCounter = 0;						// used in the ISR


/*****************************************************************************/
int main(void)
{
	InitializeHardware();
	
    while (1)	// loop forever
    {
		if (TimerTickFlag == TRUE)
		{
			// Enable High-voltage controls:
			// Inputs: PushToRing (PB1) and 20Hz_clk (PB4)
			// Outputs: EnHVpositive (PB2) and EnHVnegative (PB3)
			if ((PORTB.IN & PIN1_bm) && (PORTB.IN & PIN4_bm))			// PushToRing true and 20Hz_clk is high
			{
				PORTB.OUTSET = PIN2_bm | PIN3_bm;	// RingGen goes positive
			}
			else if ((PORTB.IN & PIN1_bm) && ((~PORTB.IN) & PIN4_bm))	// PushToRing true and 20Hz_clk is low
			{
				PORTB.OUTCLR = PIN2_bm | PIN3_bm;	// RingGen goes negative
			}
			else																	// PushToRing false
			{
				PORTB.OUTCLR = PIN2_bm;				// HV+ set low (RingGen floating)
				PORTB.OUTSET = PIN3_bm;				// HV- set high (RingGen floating)
			}

			// One-shot routines:
			// Inputs: IncomingBuzz (PC3) and BuzzClk (PA5)
			// Outputs: OneShot25 (PA3) and Buzzer_Amp_Enable (PC1)
			// One-Shot 1 is set for 25 ms
			// One-Shot 2 is set for 150 ms
			if (PORTC.IN & PIN3_bm)			// IncomingBuzz pin
			{
				IncomingBuzz = TRUE;
			}
			else
			{
				IncomingBuzz = FALSE;
			}
			
			
			// One-shot 1 routine: (25 ms)
			if (IncomingBuzz && IncomingBuzzPrevious && (~IncomingBuzzPreviousPrevious))		// rising edge (debounced)
			{
				OneShot1Counter = 2;				// Timer Tick is 8.33 ms, one-shot set for 25 ms, hence counter = (25ms/8.33ms) - 1 = 2
				OneShot1State = TRUE;
				PORTA.OUTSET = PIN3_bm;
			}
			else
			{
				if (OneShot1Counter != 0) OneShot1Counter--;
			}
			
			if (OneShot1Counter == 0)
			{
				OneShot1State = FALSE;
				PORTA.OUTCLR = PIN3_bm;
			}
			
			// One-shot 2 routine (150 ms, re-triggerable):
			if (IncomingBuzz && IncomingBuzzPrevious)				// rising edge (debounced)
			{
				OneShot2Counter = 18;				// Timer Tick is 8.33 ms, one-shot set for 150 ms, hence counter = 150ms/8.33mm = 18
			}
			if (OneShot2Counter != 0)
			{
				OneShot2Counter--;
				OneShot2State = TRUE;
				PORTC.OUTSET = PIN1_bm;
			}
			else
			{
				OneShot2State = FALSE;
				PORTC.OUTCLR = PIN1_bm;
			}
			
			
			// End of loop cleanup code:
			TimerTickFlag = FALSE;									// done with the loop
			IncomingBuzzPrevious = IncomingBuzz;					// used for de-bounced rising edge detector
			IncomingBuzzPreviousPrevious = IncomingBuzzPrevious;	// used for de-bounced rising edge detector
		}
    } // end while(forever)
} // end main()

